## boards/main/Kconfig.projbuild
```kconfig
menu "Rocket board configuration"
    orsource "$IDF_PATH/examples/common_components/env_caps/$IDF_TARGET/Kconfig.env_caps"

    config I2C_SDA_GPIO
        int "I2C SDA GPIO number"
        range ENV_GPIO_RANGE_MIN ENV_GPIO_OUT_RANGE_MAX
        default 7
    
    config I2C_SCL_GPIO
        int "I2C SCL GPIO number"
        range ENV_GPIO_RANGE_MIN ENV_GPIO_OUT_RANGE_MAX
        default 6

    config BME280_I2C_ADDR
        hex "BME280 I2C address"
        range 0x00 0xFF
        default 0x76

    config LSM6DSO_I2C_ADDR
        hex "LSM6DSO I2C address"
        range 0x00 0xFF
        default 0x6B

    config GPS_UART_TX_GPIO
        int "GPS UART TX GPIO number"
        range ENV_GPIO_RANGE_MIN ENV_GPIO_OUT_RANGE_MAX
        default 15

    config GPS_UART_RX_GPIO
        int "GPS UART RX GPIO number"
        range ENV_GPIO_RANGE_MIN ENV_GPIO_OUT_RANGE_MAX
        default 16

    config LORA_NSS_GPIO
        int "LORA NSS GPIO number"
        range ENV_GPIO_RANGE_MIN ENV_GPIO_OUT_RANGE_MAX
        default 5

    config LORA_SCK_GPIO
        int "LORA SCK GPIO number"
        range ENV_GPIO_RANGE_MIN ENV_GPIO_OUT_RANGE_MAX
        default 6

    config LORA_MOSI_GPIO
        int "LORA MOSI GPIO number"
        range ENV_GPIO_RANGE_MIN ENV_GPIO_OUT_RANGE_MAX
        default 7

    config LORA_MISO_GPIO
        int "LORA MISO GPIO number"
        range ENV_GPIO_RANGE_MIN ENV_GPIO_OUT_RANGE_MAX
        default 8

    config LORA_NRST_GPIO
        int "LORA MRST GPIO number"
        range ENV_GPIO_RANGE_MIN ENV_GPIO_OUT_RANGE_MAX
        default 9

    config LORA_BUSY_GPIO
        int "LORA BUSY GPIO number"
        range ENV_GPIO_RANGE_MIN ENV_GPIO_OUT_RANGE_MAX
        default 10

    config GPS_UART_BAUDRATE
        int "GPS UART RX baudrate"
        range 9600 1000000
        default 115200
endmenu
```
